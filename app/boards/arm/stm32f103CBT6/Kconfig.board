## app/boards/arm/stm32f103CBT6/Kconfig.board
```kconfig
# STM32F103CBT6 board Configuration

config BOARD_STM32F103CBT6
	bool "STM32F103CBT6"
	depends on SOC_STM32F103XB
```

## app/boards/arm/stm32f103CBT6/Kconfig.defconfig
```kconfig
# STM32F103CBT6 Configuration

if BOARD_STM32F103CBT6

config BOARD
	default "stm32f103CBT6" 

endif # BOARD_STM32F103CBT6
```

## swj/boards/arm/stm32f030K6T6/Kconfig.board
```kconfig
# STM32F030K6T6 board Configuration

config BOARD_STM32F030K6T6
	bool "STM32F030K6T6"
	depends on SOC_STM32F030X4
```

## swj/boards/arm/stm32f030K6T6/Kconfig.defconfig
```kconfig
# STM32F030K6T6 Configuration

if BOARD_STM32F030K6T6

config BOARD
	default "stm32f030K6T6" 

endif # BOARD_STM32F030K6T6
```
